## linux/arch/um/config.in
```kconfig
define_bool CONFIG_USERMODE y

mainmenu_name "Linux/Usermode Kernel Configuration"

define_bool CONFIG_ISA n
define_bool CONFIG_SBUS n
define_bool CONFIG_PCI n

define_bool CONFIG_UID16 y

define_bool CONFIG_RWSEM_XCHGADD_ALGORITHM y

mainmenu_option next_comment
comment 'Code maturity level options'
bool 'Prompt for development and/or incomplete code/drivers' CONFIG_EXPERIMENTAL
endmenu

mainmenu_option next_comment
comment 'General Setup'
define_bool CONFIG_STDIO_CONSOLE y
bool 'Networking support' CONFIG_NET
bool 'System V IPC' CONFIG_SYSVIPC
bool 'BSD Process Accounting' CONFIG_BSD_PROCESS_ACCT
bool 'Sysctl support' CONFIG_SYSCTL
bool 'VMS Memory Management and I/O' CONFIG_VMS

if [ "$CONFIG_VMS" = "y" ]; then
define_bool CONFIG_IO_VMS y
define_bool CONFIG_MM_VMS y
define_bool CONFIG_EXTTWO_FS y
define_bool CONFIG_MSDOS_PARTITION y
define_bool CONFIG_PROC_FS y
define_bool CONFIG_DEVFS_FS y
define_bool CONFIG_DEVFS_MOUNT y
define_bool CONFIG_DEVPTS_FS y
define_bool CONFIG_MTD n
fi

tristate 'Kernel support for a.out binaries' CONFIG_BINFMT_AOUT
tristate 'Kernel support for ELF binaries' CONFIG_BINFMT_ELF
tristate 'Kernel support for MISC binaries' CONFIG_BINFMT_MISC
bool 'Unix98 PTY support' CONFIG_UNIX98_PTYS
if [ "$CONFIG_UNIX98_PTYS" = "y" ]; then
   int 'Maximum number of Unix98 PTYs in use (0-2048)' CONFIG_UNIX98_PTY_COUNT 256
fi
bool 'Virtual serial line' CONFIG_SSL
tristate 'Host filesystem' CONFIG_HOSTFS
bool 'Management console' CONFIG_MCONSOLE
dep_bool 'Magic SysRq key' CONFIG_MAGIC_SYSRQ $CONFIG_MCONSOLE
bool '2G/2G host address space split' CONFIG_HOST_2G_2G
bool 'Symmetric multi-processing support' CONFIG_UML_SMP
define_bool CONFIG_SMP $CONFIG_UML_SMP
string 'Default main console channel initialization' CONFIG_CON_ZERO_CHAN \
	"fd:0,fd:1"
string 'Default console channel initialization' CONFIG_CON_CHAN "xterm"
string 'Default serial line channel initialization' CONFIG_SSL_CHAN "pty"
endmenu

mainmenu_option next_comment
comment 'Loadable module support'
bool 'Enable loadable module support' CONFIG_MODULES
if [ "$CONFIG_MODULES" = "y" ]; then
# MODVERSIONS does not yet work in this architecture
#   bool '  Set version information on all module symbols' CONFIG_MODVERSIONS
    bool '  Kernel module loader' CONFIG_KMOD
fi
endmenu

mainmenu_option next_comment
comment 'Devices'
define_bool CONFIG_BLK_DEV_UBD y
bool 'Always do synchronous disk IO for UBD' CONFIG_BLK_DEV_UBD_SYNC
tristate 'Loopback device support' CONFIG_BLK_DEV_LOOP
dep_tristate 'Network block device support' CONFIG_BLK_DEV_NBD $CONFIG_NET
tristate 'RAM disk support' CONFIG_BLK_DEV_RAM
if [ "$CONFIG_BLK_DEV_RAM" = "y" -o "$CONFIG_BLK_DEV_RAM" = "m" ]; then
	int '   Default RAM disk size' CONFIG_BLK_DEV_RAM_SIZE 4096
fi
dep_bool '  Initial RAM disk (initrd) support' CONFIG_BLK_DEV_INITRD $CONFIG_BLK_DEV_RAM
tristate 'Example IO memory driver' CONFIG_MMAPPER

tristate 'Sound support' CONFIG_UML_SOUND
define_tristate CONFIG_SOUND $CONFIG_UML_SOUND
define_tristate CONFIG_HOSTAUDIO $CONFIG_UML_SOUND

bool 'file descriptor channel support' CONFIG_FD_CHAN
bool 'null channel support' CONFIG_NULL_CHAN
bool 'port channel support' CONFIG_PORT_CHAN
bool 'pty channel support' CONFIG_PTY_CHAN
bool 'tty channel support' CONFIG_TTY_CHAN
bool 'xterm channel support' CONFIG_XTERM_CHAN

endmenu

if [ "$CONFIG_NET" = "y" ]; then
   source net/Config.in
fi

if [ "$CONFIG_NET" = "y" ]; then
   mainmenu_option next_comment
   comment 'Network device support'

   bool 'Virtual network device support' CONFIG_UML_NET
   if [ "$CONFIG_UML_NET" != "n" ]; then
      bool '    Ethertap transport' CONFIG_UML_NET_ETHERTAP
      bool '    TUN/TAP transport' CONFIG_UML_NET_TUNTAP
      bool '    SLIP transport' CONFIG_UML_NET_SLIP
      bool '    Daemon transport' CONFIG_UML_NET_DAEMON
      bool '    Multicast transport' CONFIG_UML_NET_MCAST
   fi

   bool 'Software network device support' CONFIG_NETDEVICES
   if [ "$CONFIG_NETDEVICES" = "y" ]; then
      source drivers/net/Config.in
   fi

   endmenu
fi

if [ "$CONFIG_VMS" != "y" ]; then
source fs/Config.in
fi

if [ "$CONFIG_VMS" != "y" ]; then
source drivers/mtd/Config.in
fi

mainmenu_option next_comment
comment 'Kernel hacking'
bool 'Debug memory allocations' CONFIG_DEBUG_SLAB
bool 'Enable kernel debugging symbols' CONFIG_DEBUGSYM
if [ "$CONFIG_XTERM_CHAN" = "y" ]; then
   dep_bool 'Enable ptrace proxy' CONFIG_PT_PROXY $CONFIG_DEBUGSYM
else 
   define_bool CONFIG_PT_PROXY n
fi
dep_bool 'Enable gprof support' CONFIG_GPROF $CONFIG_DEBUGSYM
dep_bool 'Enable gcov support' CONFIG_GCOV $CONFIG_DEBUGSYM
endmenu
```

## linux/drivers/scsi/Config.in
```kconfig
comment 'SCSI support type (disk, tape, CD-ROM)'

dep_tristate '  SCSI disk support' CONFIG_BLK_DEV_SD $CONFIG_SCSI

if [ "$CONFIG_BLK_DEV_SD" != "n" ]; then
   int  'Maximum number of SCSI disks that can be loaded as modules' CONFIG_SD_EXTRA_DEVS 40
fi

dep_tristate '  SCSI tape support' CONFIG_CHR_DEV_ST $CONFIG_SCSI

dep_tristate '  SCSI OnStream SC-x0 tape support' CONFIG_CHR_DEV_OSST $CONFIG_SCSI

dep_tristate '  SCSI CD-ROM support' CONFIG_BLK_DEV_SR $CONFIG_SCSI

if [ "$CONFIG_BLK_DEV_SR" != "n" ]; then
   bool '    Enable vendor-specific extensions (for SCSI CDROM)' CONFIG_BLK_DEV_SR_VENDOR
   int  'Maximum number of CDROM devices that can be loaded as modules' CONFIG_SR_EXTRA_DEVS 2
fi
dep_tristate '  SCSI generic support' CONFIG_CHR_DEV_SG $CONFIG_SCSI

comment 'Some SCSI devices (e.g. CD jukebox) support multiple LUNs'

#if [ "$CONFIG_EXPERIMENTAL" = "y" ]; then
   bool '  Enable extra checks in new queueing code' CONFIG_SCSI_DEBUG_QUEUES
#fi

bool '  Probe all LUNs on each SCSI device' CONFIG_SCSI_MULTI_LUN
  
bool '  Verbose SCSI error reporting (kernel size +=12K)' CONFIG_SCSI_CONSTANTS
bool '  SCSI logging facility' CONFIG_SCSI_LOGGING

mainmenu_option next_comment
comment 'SCSI low-level drivers'

if [ "$CONFIG_SGI_IP22" = "y" ]; then
   dep_tristate 'SGI WD93C93 SCSI Driver' CONFIG_SGIWD93_SCSI $CONFIG_SCSI
fi
if [ "$CONFIG_DECSTATION" = "y" ]; then
   if [ "$CONFIG_TC" = "y" ]; then
      dep_tristate 'DEC NCR53C94 Scsi Driver' CONFIG_SCSI_DECNCR $CONFIG_SCSI
   fi
   dep_tristate 'DEC SII Scsi Driver' CONFIG_SCSI_DECSII $CONFIG_SCSI
fi

if [ "$CONFIG_PCI" = "y" ]; then
   dep_tristate '3ware Hardware ATA-RAID support' CONFIG_BLK_DEV_3W_XXXX_RAID $CONFIG_SCSI
fi
dep_tristate '7000FASST SCSI support' CONFIG_SCSI_7000FASST $CONFIG_SCSI
dep_tristate 'ACARD SCSI support' CONFIG_SCSI_ACARD $CONFIG_SCSI
dep_tristate 'Adaptec AHA152X/2825 support' CONFIG_SCSI_AHA152X $CONFIG_SCSI
dep_tristate 'Adaptec AHA1542 support' CONFIG_SCSI_AHA1542 $CONFIG_SCSI
dep_tristate 'Adaptec AHA1740 support' CONFIG_SCSI_AHA1740 $CONFIG_SCSI
if [ "$CONFIG_EXPERIMENTAL" = "y" ]; then
   dep_tristate 'Adaptec AACRAID support (EXPERIMENTAL)' CONFIG_SCSI_AACRAID $CONFIG_SCSI $CONFIG_PCI
fi
source drivers/scsi/aic7xxx/Config.in
dep_tristate 'AdvanSys SCSI support' CONFIG_SCSI_ADVANSYS $CONFIG_SCSI
dep_tristate 'Always IN2000 SCSI support' CONFIG_SCSI_IN2000 $CONFIG_SCSI
dep_tristate 'AM53/79C974 PCI SCSI support' CONFIG_SCSI_AM53C974 $CONFIG_SCSI $CONFIG_PCI
dep_tristate 'AMI MegaRAID support' CONFIG_SCSI_MEGARAID $CONFIG_SCSI

dep_tristate 'DMX3191D SCSI support' CONFIG_SCSI_DMX3191D $CONFIG_SCSI $CONFIG_PCI
dep_tristate 'DTC3180/3280 SCSI support' CONFIG_SCSI_DTC3280 $CONFIG_SCSI
dep_tristate 'NCR53c406a SCSI support' CONFIG_SCSI_NCR53C406A $CONFIG_SCSI
dep_tristate 'NCR53c7,8xx SCSI support'  CONFIG_SCSI_NCR53C7xx $CONFIG_SCSI $CONFIG_PCI
if [ "$CONFIG_SCSI_NCR53C7xx" != "n" ]; then
   bool '  always negotiate synchronous transfers' CONFIG_SCSI_NCR53C7xx_sync
   bool '  allow FAST-SCSI [10MHz]' CONFIG_SCSI_NCR53C7xx_FAST
   bool '  allow DISCONNECT' CONFIG_SCSI_NCR53C7xx_DISCONNECT
fi
if [ "$CONFIG_PCI" = "y" ]; then
   dep_tristate 'SYM53C8XX Version 2 SCSI support' CONFIG_SCSI_SYM53C8XX_2 $CONFIG_SCSI
   if [ "$CONFIG_SCSI_SYM53C8XX_2" != "n" ]; then
      int  '  DMA addressing mode' CONFIG_SCSI_SYM53C8XX_DMA_ADDRESSING_MODE 1
      int  '  default tagged command queue depth' CONFIG_SCSI_SYM53C8XX_DEFAULT_TAGS 16
      int  '  maximum number of queued commands' CONFIG_SCSI_SYM53C8XX_MAX_TAGS 64
      bool '  use normal IO' CONFIG_SCSI_SYM53C8XX_IOMAPPED
   fi
fi
if [ "$CONFIG_PCI" = "y" -a "$CONFIG_SCSI_SYM53C8XX_2" != "y" ]; then
   dep_tristate 'NCR53C8XX SCSI support' CONFIG_SCSI_NCR53C8XX $CONFIG_SCSI
   dep_tristate 'SYM53C8XX SCSI support' CONFIG_SCSI_SYM53C8XX $CONFIG_SCSI
   if [ "$CONFIG_SCSI_NCR53C8XX" != "n" -o "$CONFIG_SCSI_SYM53C8XX" != "n" ]; then
      int  '  default tagged command queue depth' CONFIG_SCSI_NCR53C8XX_DEFAULT_TAGS 8
      int  '  maximum number of queued commands' CONFIG_SCSI_NCR53C8XX_MAX_TAGS 32
      int  '  synchronous transfers frequency in MHz' CONFIG_SCSI_NCR53C8XX_SYNC 20
      bool '  enable profiling' CONFIG_SCSI_NCR53C8XX_PROFILE
      bool '  use normal IO' CONFIG_SCSI_NCR53C8XX_IOMAPPED
      if [ "$CONFIG_SCSI_SYM53C8XX" != "n" ]; then
	 bool '  include support for the NCR PQS/PDS SCSI card' CONFIG_SCSI_NCR53C8XX_PQS_PDS
      fi
      if [ "$CONFIG_SCSI_NCR53C8XX_DEFAULT_TAGS" = "0" ]; then
	 bool '  not allow targets to disconnect' CONFIG_SCSI_NCR53C8XX_NO_DISCONNECT
      fi
      if [ "$CONFIG_EXPERIMENTAL" = "y" ]; then
	 bool '  assume boards are SYMBIOS compatible (EXPERIMENTAL)' CONFIG_SCSI_NCR53C8XX_SYMBIOS_COMPAT
      fi
   fi
fi
dep_tristate 'PAS16 SCSI support' CONFIG_SCSI_PAS16 $CONFIG_SCSI
dep_tristate 'PCI2000 support' CONFIG_SCSI_PCI2000 $CONFIG_SCSI
dep_tristate 'PCI2220i support' CONFIG_SCSI_PCI2220I $CONFIG_SCSI
if [ "$CONFIG_X86" = "y" ]; then
   dep_tristate 'Seagate ST-02 and Future Domain TMC-8xx SCSI support' CONFIG_SCSI_SEAGATE $CONFIG_SCSI
fi
dep_tristate 'Simple 53c710 SCSI support (Compaq, NCR machines)' CONFIG_SCSI_SIM710 $CONFIG_SCSI
dep_tristate 'Symbios 53c416 SCSI support' CONFIG_SCSI_SYM53C416 $CONFIG_SCSI
if [ "$CONFIG_PCI" = "y" ]; then
   dep_tristate 'Tekram DC390(T) and Am53/79C974 SCSI support' CONFIG_SCSI_DC390T $CONFIG_SCSI
   if [ "$CONFIG_SCSI_DC390T" != "n" ]; then
      bool '  _omit_ support for non-DC390 adapters' CONFIG_SCSI_DC390T_NOGENSUPP
   fi
fi
dep_tristate 'Trantor T128/T128F/T228 SCSI support' CONFIG_SCSI_T128 $CONFIG_SCSI
dep_tristate 'UltraStor 14F/34F support' CONFIG_SCSI_U14_34F $CONFIG_SCSI
   if [ "$CONFIG_SCSI_U14_34F" != "n" ]; then
      bool '  enable elevator sorting' CONFIG_SCSI_U14_34F_LINKED_COMMANDS
      int  '  maximum number of queued commands' CONFIG_SCSI_U14_34F_MAX_TAGS 8
   fi
if [ "$CONFIG_X86" = "y" ]; then
   dep_tristate 'UltraStor SCSI support' CONFIG_SCSI_ULTRASTOR $CONFIG_SCSI
fi
#
# Note - this is a very special 'host' adapter that simulates the presence of some disks.
# It can come in very handy for troubleshooting.  Anyone else is welcome to use it - all
# you do is hack it to simulate the condition you want to test for, and then use it.
#
# The actual configuration in any kernel release could change at any time as I hack it to
# simulate various conditions that I am testing.
#
if [ "$CONFIG_EXPERIMENTAL" = "y" ]; then
   dep_tristate 'SCSI debugging host simulator (EXPERIMENTAL)' CONFIG_SCSI_DEBUG $CONFIG_SCSI
fi
```

## linux/fs/Config.in
```kconfig
#
# File system configuration
#
mainmenu_option next_comment
comment 'File systems'

bool '/proc file system support' CONFIG_PROC_FS

dep_bool '/dev file system support (EXPERIMENTAL)' CONFIG_DEVFS_FS $CONFIG_EXPERIMENTAL
dep_bool '  Automatically mount at boot' CONFIG_DEVFS_MOUNT $CONFIG_DEVFS_FS
dep_bool '  Debug devfs' CONFIG_DEVFS_DEBUG $CONFIG_DEVFS_FS

# It compiles as a module for testing only.  It should not be used
# as a module in general.  If we make this "tristate", a bunch of people
# who don't know what they are doing turn it on and complain when it
# breaks.
dep_bool '/dev/pts file system for Unix98 PTYs' CONFIG_DEVPTS_FS $CONFIG_UNIX98_PTYS

tristate 'Second extended fs support' CONFIG_EXT2_FS

mainmenu_option next_comment
comment 'Partition Types'
source fs/partitions/Config.in
endmenu
endmenu
```
